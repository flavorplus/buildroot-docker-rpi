## Config.in
```kconfig
source "$BR2_EXTERNAL_BR_RPI_EXAMPLE_PATH/package/pkg-1/Config.in"
source "$BR2_EXTERNAL_BR_RPI_EXAMPLE_PATH/package/pkg-2/Config.in"

config BR_RPI_EXAMPLE_FLASH_ADDR
  hex "my-board flash address"
  default 0x10AD
```

## configs/raspberrypi3_defconfig
```kconfig
BR2_arm=y
BR2_cortex_a53=y
BR2_ARM_FPU_NEON_VFPV4=y

BR2_CCACHE=y

BR2_TOOLCHAIN_BUILDROOT_CXX=y
BR2_TOOLCHAIN_BUILDROOT_WCHAR=y

BR2_SYSTEM_DHCP="eth0"

BR2_GLOBAL_PATCH_DIR="$(BR2_EXTERNAL_BR_RPI_EXAMPLE_PATH)/board/br-rpi-example/patches/"

# Linux headers same as kernel, a 4.14 series
BR2_PACKAGE_HOST_LINUX_HEADERS_CUSTOM_4_14=y

BR2_LINUX_KERNEL=y
BR2_LINUX_KERNEL_CUSTOM_TARBALL=y
BR2_LINUX_KERNEL_CUSTOM_TARBALL_LOCATION="$(call github,raspberrypi,linux,865ddc1393f558198e7e7ce70928ff2e49c4f7f6)/linux-865ddc1393f558198e7e7ce70928ff2e49c4f7f6.tar.gz"
BR2_LINUX_KERNEL_DEFCONFIG="bcm2709"
BR2_LINUX_KERNEL_USE_CUSTOM_CONFIG=y
BR2_LINUX_KERNEL_CUSTOM_CONFIG_FILE="$(BR2_EXTERNAL_BR_RPI_EXAMPLE_PATH)/board/br-rpi-example/kernel.config"

# Build the DTB from the kernel sources
BR2_LINUX_KERNEL_DTS_SUPPORT=y
BR2_LINUX_KERNEL_INTREE_DTS_NAME="bcm2710-rpi-3-b bcm2710-rpi-3-b-plus bcm2710-rpi-cm3"

BR2_PACKAGE_BUSYBOX_CONFIG="$(BR2_EXTERNAL_BR_RPI_EXAMPLE_PATH)/board/br-rpi-example/busybox.config"
BR2_PACKAGE_BUSYBOX_WATCHDOG=y

BR2_PACKAGE_B43_FIRMWARE=y
BR2_PACKAGE_LINUX_FIRMWARE_BRCM_BCM43XX=y
BR2_PACKAGE_RPI_BT_FIRMWARE=y
BR2_PACKAGE_RPI_FIRMWARE=y
BR2_PACKAGE_RPI_WIFI_FIRMWARE=y
BR2_PACKAGE_RPI_USERLAND=y
BR2_PACKAGE_DROPBEAR=y
# BR2_PACKAGE_DROPBEAR_CLIENT is not set
# BR2_PACKAGE_DROPBEAR_SMALL is not set
BR2_PACKAGE_WIRELESS_TOOLS=y
BR2_PACKAGE_WPA_SUPPLICANT=y
BR2_PACKAGE_WPA_SUPPLICANT_AP_SUPPORT=y
BR2_PACKAGE_WPA_SUPPLICANT_MESH_NETWORKING=y
BR2_PACKAGE_WPA_SUPPLICANT_AUTOSCAN=y
BR2_PACKAGE_WPA_SUPPLICANT_EAP=y
BR2_PACKAGE_WPA_SUPPLICANT_DEBUG_SYSLOG=y
BR2_PACKAGE_WPA_SUPPLICANT_WPS=y
BR2_PACKAGE_WPA_SUPPLICANT_CLI=y
BR2_PACKAGE_WPA_SUPPLICANT_WPA_CLIENT_SO=y
BR2_PACKAGE_NANO=y

# Required tools to create the SD image
BR2_PACKAGE_HOST_DOSFSTOOLS=y
BR2_PACKAGE_HOST_GENIMAGE=y
BR2_PACKAGE_HOST_MTOOLS=y

BR2_TARGET_GENERIC_HOSTNAME="rpi-example"
BR2_TARGET_GENERIC_ISSUE="Welcome to RPi with example"
BR2_ROOTFS_DEVICE_CREATION_DYNAMIC_MDEV=y
BR2_TARGET_GENERIC_ROOT_PASSWD="raspberry"
BR2_TARGET_TZ_INFO=y
BR2_TARGET_LOCALTIME="Europe/Amsterdam"

# Filesystem / image
BR2_TARGET_ROOTFS_EXT2=y
BR2_TARGET_ROOTFS_EXT2_4=y
# BR2_TARGET_ROOTFS_TAR is not set
BR2_ROOTFS_MERGED_USR=y
BR2_ROOTFS_OVERLAY="$(BR2_EXTERNAL_BR_RPI_EXAMPLE_PATH)/board/br-rpi-example/rootfs_overlay/"
BR2_ROOTFS_POST_BUILD_SCRIPT="board/br-rpi-example/post-build.sh"
BR2_ROOTFS_POST_IMAGE_SCRIPT="board/br-rpi-example/post-image.sh"
BR2_ROOTFS_POST_SCRIPT_ARGS="--add-pi3-miniuart-bt-overlay"
```
